## conf/bblayers.conf
```bitbake
# LAYER_CONF_VERSION is increased each time build/conf/bblayers.conf
# changes incompatibly
LCONF_VERSION = "6"

BBPATH = "${TOPDIR}"
BBFILES ?= ""

BBLAYERS ?= " \
	${TOPDIR}/../poky/meta \
	${TOPDIR}/../poky/meta-yocto \
	${TOPDIR}/../poky/meta-yocto-bsp \
	${TOPDIR}/../oe-core/meta-oe \
	${TOPDIR}/../oe-core/meta-efl \
	${TOPDIR}/../meta-openinkpot \
	"
BBLAYERS_NON_REMOVABLE ?= " \
	${TOPDIR}/../poky/meta \
	${TOPDIR}/../poky/meta-yocto \
	"
```
